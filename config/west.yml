## config/west.yml
```yaml
manifest:
  remotes:
    - name: zmkfirmware
      url-base: https://github.com/zmkfirmware
    - name: pete
      url-base: https://github.com/petejohanson
  projects:
    - name: zmk
      remote: pete
      revision: sensors/processing-refactor-transparent-response-fix
      import: app/west.yml
  self:
    path: config
```
